/**********************************************************************
作者：套套
邮箱：2011543651@qq.com
功能：用于演示STC15使用tiny51系统的例子
		闪烁P10和P11，并使用定时器2闪烁P12

**********************************************************************/
#include <rtx51tny.h>
#include <STC12C5A60S2.H>

/**********************************************************************
	STC生成的定时器1毫秒初始化函数
**********************************************************************/
void Timer1Init(void)		//1毫秒@12.000MHz
{
	AUXR &= 0xBF;		//定时器时钟12T模式
	TMOD &= 0x0F;		//设置定时器模式
	TL1 = 0x66;		//设置定时初值
	TH1 = 0xFC;		//设置定时初值
	TF1 = 0;		//清除TF1标志
	TR1 = 1;		//定时器1开始计时
	ET1 = 1;
}

/**********************************************************************
	第一个任务，用于初始化。
**********************************************************************/
void Init() _task_ 0  {                  
	os_create_task (1);		  //创建第一个任务	
	os_create_task (2);		  //创建第二个任务	
	Timer1Init();			  //进行定时器1的初始化	

	os_delete_task (0);		  //初始化完毕，删除自身任务
}

/**********************************************************************
	第二个任务，闪烁P10。
**********************************************************************/
void LED1() _task_ 1{
	while (1)  {
		ET0 = 0; 			  //关闭定时器0，进行关键代码保护
								//tiny51采用定时器0的模式1作为时钟
								//默认为10000个机器周期。在STC15中为12T模式，与传统51无异
								//注意：关键代码时间不能太长，否则会影响整个系统运行。
		P10 = ~P10;
		ET0 = 1;			  //打开定时器0，即重新启动系统
		os_wait2 (K_TMO, 50); //等待50个系统周期，约0.5秒
		/*RTX51Tiny默认的时钟中断是10000个机器周期，因此对于一个运行在12MHz时钟标准8051而言，内核的时钟就是100Hz（周期0.01秒），计算公式就是：12MHz/12/10000。这个值可以通过配置文件CONF_TNY.A51来更改。*/
	}
}

/**********************************************************************
	第三个任务，闪烁P11。
**********************************************************************/
void LED2() _task_ 2{
	
	while(1){
		P11 = ~P11;
		os_wait2 (K_TMO, 50);  ////等待50个系统周期，约0.5秒		
	}
}

/**********************************************************************
	定时器1的中断，1ms进入一次
**********************************************************************/
void Timer1() interrupt 3{
	static int i;
	i++;
	if(i == 500){
		i = 0;
		P13 = ~P13; 
	}	
}


//void main(){
//	Timer1Init();
//	EA = 1;
//	while(1){
//		;
//	}
//}