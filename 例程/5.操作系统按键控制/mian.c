/**********************************************************************
作者：套套
邮箱：2011543651@qq.com
功能：用于演示STC15使用tiny51系统的例子
		使用keil官方的Tiny用串口函数进行串口命令读取并回显

**********************************************************************/
#include <rtx51tny.h>
#include <config.H>
#include <stdio.h>
#include <12864.h>
#include <delay.h>

#define os_enter_critical() ET0=0
#define os_exit_critical() 	ET0=1

/**********************************************************************
	第一个任务，用于初始化。
**********************************************************************/
void Init() _task_ 0  {                  
	os_create_task (1);		  //创建第一个任务	
	os_create_task (2);		  //创建第二个任务
	os_create_task (3);		  //创建第二个任务			
	Lcd_init();
	Lcd_str(0, 0, "1 OFF!");
	Lcd_str(1, 0, "2 OFF!");
	os_delete_task (0);		  //初始化完毕，删除自身任务
}

///**********************************************************************
//	第二个任务，使用按键驱动屏幕显示
//**********************************************************************/
void LED1() _task_ 1{
	while (1)  {
		if(P32 == 0){
			os_wait2 (K_TMO, 1);
			if(P32 == 0){
				os_send_signal (2);	
			}
			while(!P32);
			Lcd_str(0, 0, "                ");
		 	Lcd_str(0, 0, "1 OFF!");				//显示内容
		}
		if(P33 == 0){
			os_wait2 (K_TMO, 1);
			if(P33 == 0){
				os_send_signal (3);	
			}
			while(!P33);
			Lcd_str(1, 0, "                ");
		 	Lcd_str(1, 0, "2 OFF!");				//显示内容
		}
	}
}

/**********************************************************************
	第三个任务，使用12864进行驱动显示按键按下了按键1
**********************************************************************/
void LCD1() _task_ 2{
	while(1){
		os_wait2 (K_SIG, 0);
		Lcd_str(0, 0, "                ");
	 	Lcd_str(0, 0, "1 ON!");				//显示内容
		P11 = ~P11;
	}
}
/**********************************************************************
	第三个任务，使用12864进行驱动显示按键按下了按键2
**********************************************************************/
void LCD2() _task_ 3{
	while(1){
		os_wait2 (K_SIG, 0);
		Lcd_str(1, 0, "                ");
	 	Lcd_str(1, 0, "2 ON!");				//显示内容
		P11 = ~P11;
	}
}


//void main(){
//	Timer1Init();
//	EA = 1;
//	while(1){
//		;
//	}
//}